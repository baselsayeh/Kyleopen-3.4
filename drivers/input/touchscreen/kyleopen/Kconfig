## drivers/input/touchscreen/kyleopen/Kconfig
```kconfig
if INPUT_TOUCHSCREEN

config TOUCHSCREEN_MELFAS_KYLE
	tristate "Melfas i2c touchscreen"
	depends on I2C
	help
		This enable support for Melfas over I2C based touchscreen.

endif
```
